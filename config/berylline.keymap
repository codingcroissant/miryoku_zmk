// Copyright 2022 Manna Harbour
// https://github.com/manna-harbour/miryoku

#include "../miryoku/custom_config.h"
#include "../miryoku/mapping/30/hummingbird.h"
#include "../miryoku/miryoku.dtsi"
/ {
  chosen {
    zmk,kscan = &kscan_facedown;
  };
};
